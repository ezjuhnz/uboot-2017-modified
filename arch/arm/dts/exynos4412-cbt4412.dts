/*
 * Samsung's Exynos4210 based Origen board device tree source
 *
 * Copyright (c) 2014 Samsung Electronics Co., Ltd.
 *		http://www.samsung.com
 *
 * SPDX-License-Identifier:	GPL-2.0+
 */

/dts-v1/;
#include "skeleton.dtsi"
#include "exynos4412.dtsi"

/ {
	model = "CBT4412 board based on Exynos4412";
	compatible = "insignal,cbt4412", "samsung,exynos4412";

	chosen {
		bootargs ="";
	};

	aliases {
		serial0 = "/serial@13800000";
		serial1 = "/serial@13800020";
		console = "/serial@13820000";
	};
};

&sdhci2 {
	samsung,bus-width = <4>;
	samsung,timing = <1 2 3>;
	cd-gpios = <&gpk2 2 0>;
	status = "okay";
};
